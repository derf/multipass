## src/app/datalogger/Kconfig
```kconfig
# Copyright 2020 Birte Kristina Friesel
#
# SPDX-License-Identifier: CC0-1.0

prompt "Data Logger for Arbitrary Devices"
depends on loop && !wakeup

config app_datalogger_compact
bool "Compact output, e.g. for datalog-to-influxdb.py"
depends on app_datalogger
```

## src/app/tfmicro-test/Kconfig
```kconfig
# Copyright 2020 Birte Kristina Friesel
#
# SPDX-License-Identifier: CC0-1.0

prompt "TFLite micro test"
depends on lib_tfmicro_stm32 && meta_driver_counter && !loop && !wakeup

config app_tfmicro_test_arena_size
int "Tensor Arena Size [KiB]"
default 4
depends on app_tfmicro_test
```
