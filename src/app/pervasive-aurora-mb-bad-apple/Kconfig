## src/app/stream/Kconfig
```kconfig
# Copyright 2020 Birte Kristina Friesel
#
# SPDX-License-Identifier: CC0-1.0

prompt "STREAM Benchmark"
depends on meta_driver_counter && !loop && !wakeup

config app_stream_type
string "Type"
depends on app_stream
default "unsigned int"

config app_stream_n_elements
int "# Elements"
depends on app_stream
default 128 if arch_arduino_nano
default 8192 if arch_rm46l8lp
default 8192 if arch_stm32f746zg_nucleo

config app_stream_stride
int "Stride"
depends on app_stream
default 1
```

## src/arch/arduino-nano/Kconfig
```kconfig
# Copyright 2020-2024 Birte Kristina Friesel
#
# SPDX-License-Identifier: CC0-1.0

config arch_arduino_nano_cpufreq
int "CPU Frequency"
#!accept [62500, 125000, 250000, 500000, 1000000, 2000000, 4000000, 8000000, 16000000]
range 62500 16000000
default 16000000
help
  Assumes an externel 16MHz crystal to be present
  Must be one of 62500, 125000, 250000, 500000, 1000000, 2000000, 4000000, 8000000, 16000000.

config arch_arduino_nano_driver_adc
bool "ADC on PC<0-5>"
help
  ADC0: PC0
  ADC1: PC1
  ADC2: PC2
  ADC3: PC3
  ADC4: PC4
  ADC5: PC5
  ADC6: ---
  ADC7: ---
select meta_driver_adc

config arch_arduino_nano_driver_i2c
bool "I²C on PC[45]"
help
  SDA: PC4
  SCL: PC5
select meta_driver_hardware_i2c
select meta_driver_i2c

config arch_arduino_nano_driver_neopixel
bool "WS2812b (NeoPixel)"
select meta_driver_neopixel

config arch_arduino_nano_driver_spi
bool "SPI on PB[2345]"
help
  SS: PB2
  MOSI: PB3
  MISO: PB4
  SCK: PB5
select meta_driver_spi

config arch_arduino_nano_driver_stdin
bool "UART Input on PD0"
help
  RX: PD0 (USB)
select meta_driver_stdin

config arch_arduino_nano_driver_timer
bool "Timer with Interrupts"
select meta_driver_timer

config arch_arduino_nano_driver_dmx
bool "DMX"
select meta_driver_dmx

config arch_arduino_nano_driver_dmx_pin
string "DMX Pin"
default "pb5"
depends on arch_arduino_nano_driver_dmx

choice arch_arduino_nano_cpu
bool "CPU Type"

config arch_arduino_nano_mega328
bool "ATMega328"

config arch_arduino_nano_mega168
bool "ATMega168"

endchoice

choice arch_arduino_nano_timer1

bool "Timer 1"
optional

config arch_arduino_nano_driver_uptime
bool "Uptime Counter"
select meta_driver_uptime

config arch_arduino_nano_driver_counter
bool "Cycle Counter"
select meta_driver_counter

endchoice
```

## src/arch/atmega2560/Kconfig
```kconfig
# Copyright 2021 Birte Kristina Friesel
#
# SPDX-License-Identifier: CC0-1.0

config arch_atmega2560_driver_dmx1
bool "DMX1 Output on PD3 (D18)"
help
  TX: PD3 (UART1) (D18)
select meta_driver_dmx

config arch_atmega2560_driver_dmx2
bool "DMX2 Output on PH1 (D16)"
help
  TX: PH1 (UART2) (D16)
select meta_driver_dmx

config arch_atmega2560_driver_dmx3
bool "DMX3 Output on PJ1 (D14)"
help
  TX: PJ1 (UART3) (D14)
select meta_driver_dmx

config arch_atmega2560_driver_i2c
bool "I2C"
select meta_driver_hardware_i2c
select meta_driver_i2c

config arch_atmega2560_driver_stdout1
bool "UART1 Output on PD3 (D18)"
help
  TX: PD3 (UART1) (D18)
select meta_driver_stdout1

config arch_atmega2560_uart1_baud
int "UART1 Baud Rate"
range 9600 249600
default 57600
depends on arch_atmega2560_driver_stdout1

config arch_atmega2560_driver_stdout2
bool "UART2 Output on PH1 (D16)"
help
  TX: PH1 (UART2) (D16)
select meta_driver_stdout2

config arch_atmega2560_uart2_baud
int "UART2 Baud Rate"
range 9600 249600
default 57600
depends on arch_atmega2560_driver_stdout2

config arch_atmega2560_driver_stdout3
bool "UART3 Output on PJ1 (D14)"
help
  TX: PJ1 (UART3) (D14)
select meta_driver_stdout3

config arch_atmega2560_uart3_baud
int "UART3 Baud Rate"
range 9600 249600
default 57600
depends on arch_atmega2560_driver_stdout3

config arch_atmega2560_driver_stdin
bool "UART0 Input on PE0 (RX)"
help
  RX: PE0 (UART0) (RX)
select meta_driver_stdin

config arch_atmega2560_driver_stdin1
bool "UART1 Input on PD2 (D19)"
help
  RX: PD2 (UART1) (D19)
depends on arch_atmega2560_driver_stdout1
select meta_driver_stdin1

config arch_atmega2560_driver_stdin2
bool "UART2 Input on PH0 (D17)"
help
  RX: PH0 (UART2) (D17)
depends on arch_atmega2560_driver_stdout2
select meta_driver_stdin2

config arch_atmega2560_driver_stdin3
bool "UART3 Input on PE0 (RX)"
help
  RX: PE0 (UART0) (RX)
depends on arch_atmega2560_driver_stdout3
select meta_driver_stdin3

config arch_atmega2560_driver_timer
bool "Timer with Interrupts"
select meta_driver_timer
```

## src/arch/blinkenrocket/Kconfig
```kconfig
# Copyright 2020 Daniel Friesel
#
# SPDX-License-Identifier: CC0-1.0
config arch_blinkenrocket_driver_i2c
bool "I2C"
select meta_driver_hardware_i2c
select meta_driver_i2c

config arch_blinkenrocket_driver_uptime
bool "Uptime Counter"
select meta_driver_uptime

config arch_blinkenrocket_kout_nop
bool "Disable UART emulation for stdout"
```

## src/arch/esp8266/Kconfig
```kconfig
# Copyright 2020 Daniel Friesel
#
# SPDX-License-Identifier: CC0-1.0
config arch_esp8266_driver_counter
bool "Cycle Counter"
select meta_driver_counter

config arch_esp8266_driver_stdin
bool "UART Input"
select meta_driver_stdin

config arch_esp8266_driver_uptime
bool "Uptime Counter"
select meta_driver_uptime
```

## src/arch/infineon-tc1796-mock/Kconfig
```kconfig
# Copyright 2022 Daniel Friesel
#
# SPDX-License-Identifier: CC0-1.0

config arch_infineon_tc1796_mock_driver_counter
bool "Cycle Counter"
select meta_driver_counter
```
