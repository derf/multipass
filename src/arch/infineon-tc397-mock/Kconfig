## src/arch/lora32u4ii/Kconfig
```kconfig
# Copyright 2021 Birte Kristina Friesel
#
# SPDX-License-Identifier: CC0-1.0

config arch_lora32u4ii_cpufreq
int "CPU Frequency"
#!accept [62500, 125000, 250000, 500000, 1000000, 2000000, 4000000, 8000000]
range 62500 8000000
default 8000000
help
  Assumes an externel 8MHz crystal to be present

config arch_lora32u4ii_driver_adc
bool "ADC (Analog-Digital-Converter)"
select meta_driver_adc

config arch_lora32u4ii_driver_spi
bool "SPI"
select meta_driver_spi

config arch_lora32u4ii_driver_uptime
bool "Uptime Counter"
select meta_driver_uptime
```

## src/arch/msp430fr5969lp/Kconfig
```kconfig
# Copyright 2020 Birte Kristina Friesel
#
# SPDX-License-Identifier: CC0-1.0
config arch_msp430fr5969lp_driver_adc
bool "ADC (Analog-Digital-Converter)"
select meta_driver_adc

config arch_msp430fr5969lp_driver_counter
bool "Cycle Counter"
select meta_driver_counter

config arch_msp430fr5969lp_driver_dmx1
bool "DMX Output on eUSCI_A1 / P2.5"
depends on !meta_driver_stdout1
select meta_driver_dmx
select meta_driver_dmx1

config arch_msp430fr5969lp_driver_i2c
bool "I²C on eUSCI_B0 / P1.[67]"
help
  SDA: P1.6
  SCL: P1.7
select meta_driver_hardware_i2c
select meta_driver_i2c

config arch_msp430fr5969lp_driver_spi
bool "SPI on eUSCI_B0"
select meta_driver_spi

config arch_msp430fr5969lp_driver_stdout1
bool "UART Output on eUSCI_A1 / P2.5"
help
  TX: P2.5 (eUSCI_A1 / UCA1TXD)
select meta_driver_stdout1

config arch_msp430fr5969lp_driver_stdin
bool "UART Input on eUSCI_A0 / P2.1"
help
  RX: P2.1 (eUSCI_A0 / UCA0RXD)
select meta_driver_stdin

config arch_msp430fr5969lp_driver_stdin1
bool "UART Input on eUSCI_A1 / P2.6"
help
  RX: P2.6 (eUSCI_A1 / UCA1RXD)
depends on arch_msp430fr5969lp_driver_stdout1
select meta_driver_stdin1

config arch_msp430fr5969lp_driver_timer
bool "Timer with Interrupts"
select meta_driver_timer

config arch_msp430fr5969lp_driver_uptime
bool "Uptime Counter"
select meta_driver_uptime
```

## src/arch/msp430fr5994lp-256k/Kconfig
```kconfig
config arch_msp430fr5994lp_256k_driver_adc
bool "ADC (Analog-Digital-Converter)"
select meta_driver_adc

config arch_msp430fr5994lp_256k_driver_counter
bool "Cycle Counter"
select meta_driver_counter

config arch_msp430fr5994lp_256k_driver_i2c
bool "I2C on eUSCI_B1"
select meta_driver_i2c

config arch_msp430fr5994lp_256k_driver_spi_a1
bool "SPI on eUSCI_A1"
select meta_driver_spi

config arch_msp430fr5994lp_256k_driver_spi_b
bool "SPI on eUSCI_B1"
select meta_driver_spi

config arch_msp430fr5994lp_256k_driver_stdin
bool "UART Input"
select meta_driver_stdin

config arch_msp430fr5994lp_256k_driver_timer
bool "Timer with Interrupts"
select meta_driver_timer

config arch_msp430fr5994lp_256k_driver_uptime
bool "Uptime Counter"
select meta_driver_uptime
```

## src/arch/msp430fr5994lp/Kconfig
```kconfig
# Copyright 2020 Birte Kristina Friesel
#
# SPDX-License-Identifier: CC0-1.0
config arch_msp430fr5994lp_driver_adc
bool "ADC (Analog-Digital-Converter)"
select meta_driver_adc

config arch_msp430fr5994lp_driver_counter
bool "Cycle Counter"
select meta_driver_counter

config arch_msp430fr5994lp_driver_dmx1
bool "DMX Output on eUSCI_A1 / P2.5"
depends on !meta_driver_stdout1
select meta_driver_dmx
select meta_driver_dmx1

config arch_msp430fr5994lp_driver_dmx2
bool "DMX Output on eUSCI_A2 / P5.4"
depends on !meta_driver_stdout2
select meta_driver_dmx
select meta_driver_dmx2

config arch_msp430fr5994lp_driver_dmx3
bool "DMX Output on eUSCI_A3 / P6.0"
depends on !meta_driver_stdout3
select meta_driver_dmx
select meta_driver_dmx3

config arch_msp430fr5994lp_driver_i2c
bool "I²C on eUSCI_B1 / P5.[01]"
help
  SDA: P5.0
  SCL: P5.1
select meta_driver_hardware_i2c
select meta_driver_i2c

## broken
#config arch_msp430fr5994lp_driver_spi_a1
#bool "SPI on eUSCI_A1"
#select meta_driver_spi

config arch_msp430fr5994lp_driver_spi
bool "SPI on eUSCI_B1"
select meta_driver_spi

config arch_msp430fr5994lp_driver_stdin
bool "UART Input"
select meta_driver_stdin

config arch_msp430fr5994lp_driver_timer
bool "Timer with Interrupts"
select meta_driver_timer

config arch_msp430fr5994lp_driver_uptime
bool "Uptime Counter"
select meta_driver_uptime

config arch_msp430fr5994lp_large_mode
bool "Large Memory Model (20bit pointers, 256kB FRAM)"

# config arch_msp430fr5994lp_dco_frequency
# int "DCO Frequency"
# default "16000000"
# #!accept [1000000, 2666666, 3500000, 4000000, 5333333, 7000000, 8000000, 16000000, 21000000, 24000000]
# range "1000000" "24000000"
# help
#   Specify the desired DCO frequency here. The DCO will be configured accordingly.
# 
# config arch_msp430fr5994lp_diva
# int "ACLK Divider"
# default "1"
# #!accept [1, 2, 4, 8, 16, 32]
# range "1" "32"
# 
# config arch_msp430fr5994lp_divm
# int "MCLK Divider"
# default "1"
# #!accept [1, 2, 4, 8, 16, 32]
# range "1" "32"
# 
# config arch_msp430fr5994lp_divs
# int "SMCLK Divider"
# default "1"
# #!accept [1, 2, 4, 8, 16, 32]
# range "1" "32"
# 
# config arch_msp430fr5994lp_sela
# int "ACLK Assignment"
# default "0"
# range "0" "2"
# help
#   0=LFXT or VLO, 1=VLO, 2=LFMODCLK
# 
# config arch_msp430fr5994lp_selm
# int "MCLK Assignment"
# default "3"
# range "0" "5"
# help
#   0=LFXT or VLO, 1=VLO, 2=LFMODCLK, 3=DCO, 4=MODCLK, 5=HFXT or DCO
# 
# config arch_msp430fr5994lp_sels
# int "SCLK Assignment"
# default "3"
# range "0" "5"
# help
#   0=LFXT or VLO, 1=VLO, 2=LFMODCLK, 3=DCO, 4=MODCLK, 5=HFXT or DCO
# 
# config arch_msp430fr5994lp_cpufreq
# int "CPU Frequency"
# range arch_msp430fr5994lp_lfxt_frequency arch_msp430fr5994lp_lfxt_frequency if arch_msp430fr5994lp_selm = "0" && arch_msp430fr5994lp_divm = "1"
# range 6000 14000 if arch_msp430fr5994lp_selm = "1" && arch_msp430fr5994lp_divm = "1"
# default "9400" if arch_msp430fr5994lp_selm = "1" && arch_msp430fr5994lp_divm = "1"
# range "37500" "37500" if arch_msp430fr5994lp_selm = "2" && arch_msp430fr5994lp_divm = "1"
# range arch_msp430fr5994lp_dco_frequency arch_msp430fr5994lp_dco_frequency if arch_msp430fr5994lp_selm = "3" && arch_msp430fr5994lp_divm = "1"
# range "4800000" "4800000" if arch_msp430fr5994lp_selm = "4" && arch_msp430fr5994lp_divm = "1"
# range arch_msp430fr5994lp_hfxt_frequency arch_msp430fr5994lp_hfxt_frequency if arch_msp430fr5994lp_selm = "5" && arch_msp430fr5994lp_divm = "1"

# menuconfig arch_msp430fr5994lp_lfxt
# bool "LFXT Setup"
# help
#   LFXT is connected to a 32768Hz Crystal by default.
#   Enable this option if you wish to use it.
# 
# config arch_msp430fr5994lp_lfxt_frequency
# int "LFXT Crystal/Input Frequency"
# default "32768"
# range "10000" "50000"
# depends on arch_msp430fr5994lp_lfxt
# 
# config arch_msp430fr5994lp_lfxt_drive
# int "LFXT Drive"
# default "0"
# range "0" "3"
# depends on arch_msp430fr5994lp_lfxt
# 
# config arch_msp430fr5994lp_lfxt_off
# bool "Disable LFXT"
# depends on arch_msp430fr5994lp_lfxt
# 
# config arch_msp430fr5994lp_lfxt_bypass
# bool "Bypass LFXT Amplifier (for clock input)"
# depends on arch_msp430fr5994lp_lfxt
# 
# menuconfig arch_msp430fr5994lp_hfxt
# bool "HFXT Setup"
# help
#   System clock source defaults to DCO, HFXT is unpopulated by default.
#   Enable this option if your board contains a crystal on HFXT and you wish
#   to use it.
# 
# config arch_msp430fr5994lp_hfxt_frequency
# int "HFXT Crystal/Input Frequency"
# default "16000000"
# range "0" "24000000"
# depends on arch_msp430fr5994lp_hfxt
# 
# config arch_msp430fr5994lp_hfxt_drive
# int "HFXT Drive"
# default "0"
# range "0" "3"
# depends on arch_msp430fr5994lp_hfxt
# 
# config arch_msp430fr5994lp_hfxt_off
# bool "Disable HFXT"
# depends on arch_msp430fr5994lp_hfxt
# 
# config arch_msp430fr5994lp_hfxt_bypass
# bool "Bypass HFXT Amplifier (for clock input)"
# depends on arch_msp430fr5994lp_hfxt
```

## src/arch/posix/Kconfig
```kconfig
# Copyright 2020 Daniel Friesel
#
# SPDX-License-Identifier: CC0-1.0
config gpio_trace
bool "Trace GPIO changes on stdout"

config arch_posix_driver_counter
bool "Cycle counter"
select meta_driver_counter

config arch_posix_driver_i2c
bool "I2C via /dev/i2c"
select meta_driver_hardware_i2c
select meta_driver_i2c

config arch_posix_driver_i2c_bus
string "I2C bus (/dev/i2c-* device)"
default "/dev/i2c-1"
depends on arch_posix_driver_i2c

config arch_posix_driver_uptime
bool "Uptime counter"
select meta_driver_uptime
```

## src/arch/rm46l8lp/Kconfig
```kconfig
# Copyright 2022 Birte Kristina Friesel
#
# SPDX-License-Identifier: CC0-1.0
config arch_rm46l8lp_driver_counter
bool "Cycle Counter"
select meta_driver_counter

config arch_rm46l8lp_driver_uptime
bool "Uptime Counter"
select meta_driver_uptime
```

## src/arch/stm32f446re-nucleo/Kconfig
```kconfig
# Copyright 2024 Birte Kristina Friesel
#
# SPDX-License-Identifier: CC0-1.0
config arch_stm32f446re_nucleo_driver_counter
bool "Cycle Counter"
select meta_driver_counter

config arch_stm32f446re_nucleo_driver_i2c
bool "I²C on PB[89]"
help
  SDA: PB9 (CN5 D14)
  SCL: PB8 (CN5 D15)
select meta_driver_hardware_i2c
select meta_driver_i2c

config arch_stm32f446re_nucleo_driver_i2c_fast_mode
bool "Fast Mode (400 kHz)"
depends on arch_stm32f446re_nucleo_driver_i2c

#config arch_stm32f446re_nucleo_driver_timer
#bool "Timer with Interrupts"
#select meta_driver_timer

config arch_stm32f446re_nucleo_driver_uptime
bool "Uptime Counter"
select meta_driver_uptime
```

## src/arch/stm32f746zg-nucleo/Kconfig
```kconfig
# Copyright 2024 Birte Kristina Friesel
#
# SPDX-License-Identifier: CC0-1.0
config arch_stm32f746zg_nucleo_driver_counter
bool "Cycle Counter"
select meta_driver_counter

config arch_stm32f746zg_nucleo_driver_uptime
bool "Uptime Counter"
select meta_driver_uptime

config arch_stm32f746zg_nucleo_driver_i2c
bool "I²C on PB[89]"
help
  SDA: PB9 (CN7 D14)
  SCL: PB8 (CN7 D15)
select meta_driver_hardware_i2c
select meta_driver_i2c

config arch_stm32f746zg_nucleo_driver_i2c_fast_mode
bool "Fast Mode (400 kHz)"
depends on arch_stm32f746zg_nucleo_driver_i2c
```

## src/arch/tc1796-triboard/Kconfig
```kconfig
# Copyright 2022 Daniel Friesel
#
# SPDX-License-Identifier: CC0-1.0

config arch_tc1796_triboard_driver_counter
bool "Cycle Counter"
select meta_driver_counter
```

## src/driver/Kconfig
```kconfig
# Copyright 2020 Daniel Friesel
#
# SPDX-License-Identifier: CC0-1.0

config meta_driver_adc
bool
config meta_driver_counter
bool
config meta_driver_dmx
bool
config meta_driver_hardware_i2c
bool
config meta_driver_i2c
bool
config meta_driver_neopixel
bool
config meta_driver_spi
bool
config meta_driver_stdin
bool
config meta_driver_timer
bool
config meta_driver_uptime
bool

menu "Drivers"

config driver_am2320
bool "AM2320 TH Sensor"
depends on meta_driver_i2c

config driver_bme280
bool "BME280 TPH Sensor"
depends on meta_driver_i2c

config driver_bme680
bool "BME680 TPH+IAQ Sensor"
depends on meta_driver_i2c && !driver_bme280

config driver_bme680_bsec
bool "with BSEC (proprietary library for IAQ calculation)"
depends on driver_bme680 && arch_posix
# incompatible with avr-gcc 5:
# /usr/lib/gcc/avr/5.4.0/../../../avr/bin/ld: avr:6 architecture of input file `...' is incompatible with avr:5 output

config driver_bme680_bsec_path
string "BSEC library path"
default "bme680-bsec-lite" if arch_arduino_nano
default "bme680-bsec" if arch_msp430fr5994lp
default "bme680-bsec-armv6" if arch_posix
depends on driver_bme680_bsec

config driver_bme680_bsec_save_state
bool "Save and Load library state (requires stdio)"
depends on driver_bme680_bsec

config driver_bme680_bsec_state_path
string "BSEC state path"
default "/boot/bme680-bsec.state" if arch_posix
depends on driver_bme680_bsec_save_state

config driver_ccs811
bool "CCS811 VOC Sensor"
depends on meta_driver_i2c

config driver_ds2482
bool "DS2482-100 Single-Channel 1-Wire Master"
depends on meta_driver_i2c

# dummy is AEMR-specific and not included in Kconfig

config driver_eeprom24lc64
bool "24LC64 EEPROM"
depends on meta_driver_i2c

config driver_hdc1080
bool "HDC1080 TH Sensor with Heated Plate"
depends on meta_driver_i2c

config driver_lm75
bool "LM75 Temperature Sensor"
depends on meta_driver_i2c

config driver_max44006
bool "MAX44006 RGB + IR Sensor"
depends on meta_driver_i2c

config driver_max44009
bool "MAX44009 Ambient Light Sensor"
depends on meta_driver_i2c

config driver_mmsimple
bool "MicroMoody simple"
depends on meta_driver_i2c

config driver_mmsubstate
bool "MicroMoody with Sub-States"
depends on meta_driver_i2c && !driver_mmsimple

config driver_mpu9250
bool "MPU9250 Accelerometer/Gyroscope/Magnetometer"
depends on meta_driver_i2c

config driver_nrf24l01
bool "nRF24L01+ 2.4GHz Radio"
depends on meta_driver_spi

config driver_pervasive_aurora_mb
bool "Pervasive Aurora Mb"
depends on ( arch_msp430fr5969lp || arch_msp430fr5994lp ) && meta_driver_spi

# resistive_load is AEMR-specific and not included in Kconfig

config driver_s5851a
bool "S5851 Temperature Sensor"
depends on meta_driver_i2c

config driver_scd4x
bool "Sensirion SCD4x CO2 Sensor"
depends on meta_driver_i2c

config driver_veml6075
bool "VEML6075 UV Sensor"
depends on meta_driver_i2c

config driver_sharp96
bool "sharp LS013B4DN 96x96px Transflective LC Display"
depends on ( arch_msp430fr5969lp || arch_msp430fr5994lp ) && meta_driver_spi

config driver_ssd1306
bool "SSD1306 I2C OLED display"
depends on meta_driver_i2c

config driver_ssd1306_width
int "Display width"
default 128
depends on driver_ssd1306

config driver_ssd1306_height
int "Display height"
default 64
depends on driver_ssd1306

choice driver_ssd1306_mode
bool "Addressing Mode"
depends on driver_ssd1306

config driver_ssd1306_mode_vertical
bool "Vertical"

config driver_ssd1306_mode_horizontal
bool "Horizontal bytes, Vertical bits"

endchoice

config driver_softi2c
bool "Software I2C"
#depends on !driver_i2c
select meta_driver_i2c

endmenu

menu "SoftI2C Configuration"
depends on driver_softi2c

config driver_softi2c_scl
string "SCL Pin"
default "pc5" if arch_arduino_nano
default "p1_7" if arch_msp430fr5969lp
default "p5_1" if arch_msp430fr5994lp
default "px01" if arch_posix
default "pb8" if arch_stm32f446re_nucleo

config driver_softi2c_sda
string "SDA Pin"
default "pc4" if arch_arduino_nano
default "p1_6" if arch_msp430fr5969lp
default "p5_0" if arch_msp430fr5994lp
default "px00" if arch_posix
default "pb9" if arch_stm32f446re_nucleo

choice driver_softi2c_pullup

bool "SoftI2C Pull-Up Configuration"
depends on driver_softi2c

config driver_softi2c_pullup_none
bool "No Pull-Up Handling"

config driver_softi2c_pullup_dynamic_internal
bool "Internal Dynamic Pull-Up"
help
    Internal Pull-Up, disabled when transmitting LOW

endchoice

endmenu
```
